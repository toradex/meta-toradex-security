## conf/layer.conf
```bitbake
BBPATH .= ":${LAYERDIR}"

META_TORADEX_SECURITY_LAYERDIR := "${LAYERDIR}"

BBFILES += "${LAYERDIR}/recipes-*/*/*.bb \
            ${LAYERDIR}/recipes-*/*/*.bbappend"

BBFILE_COLLECTIONS += "meta-toradex-security"
BBFILE_PATTERN_meta-toradex-security = "^${LAYERDIR}/"
BBFILE_PRIORITY_meta-toradex-security = "10"

LAYERDEPENDS_meta-toradex-security = "\
    core \
    openembedded-layer \
    security \
"

LAYERRECOMMENDS_meta-toradex-security = "\
    toradex-nxp-layer \
    toradex-ti-layer \
"

LAYERSERIES_COMPAT_meta-toradex-security = "scarthgap walnascar"

# NXP layers
BBFILES_DYNAMIC += " \
    freescale-layer:${LAYERDIR}/dynamic-layers/freescale/*/*/*.bbappend \
"

# TI layers
BBFILES_DYNAMIC += " \
    meta-ti-bsp:${LAYERDIR}/dynamic-layers/meta-ti-bsp/*/*/*.bbappend \
"

# OP-TEE layer
BBFILES_DYNAMIC += " \
    meta-arm:${LAYERDIR}/dynamic-layers/meta-arm/*/*/*.bbappend \
"

# Toradex layers
BBFILES_DYNAMIC += " \
    toradex-ti-layer:${LAYERDIR}/dynamic-layers/toradex-ti/*/*/*.bbappend \
    toradex-nxp-layer:${LAYERDIR}/dynamic-layers/toradex-nxp/*/*/*.bbappend \
    toradex-bsp-common-layer:${LAYERDIR}/dynamic-layers/toradex-bsp-common/*/*/*.bbappend \
    meta-toradex-torizon:${LAYERDIR}/dynamic-layers/meta-toradex-torizon/*/*/*.bbappend \
    toradex-tezi:${LAYERDIR}/dynamic-layers/meta-toradex-tezi/*/*/*.bbappend \
"
```
